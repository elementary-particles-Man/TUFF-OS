## TUFF-FS/tf_core/buildroot_config/tuff_defconfig
```kconfig
# Architecture
BR2_x86_64=y
BR2_x86_corei7=y

# Toolchain (Musl for static/security)
BR2_TOOLCHAIN_BUILDROOT_MUSL=y
BR2_TOOLCHAIN_BUILDROOT_CXX=y

# System
BR2_TARGET_GENERIC_HOSTNAME="tuff-node"
BR2_TARGET_GENERIC_ISSUE="Welcome to TUFF-OS (TF-Core)"
BR2_ROOTFS_DEVICE_CREATION_DYNAMIC_DEVTMPFS=y
BR2_INIT_NONE=y
BR2_ROOTFS_MERGED_USR=y
BR2_SYSTEM_BIN_SH_NONE=y

# Kernel (Linux 6.6 LTS)
BR2_LINUX_KERNEL=y
BR2_LINUX_KERNEL_CUSTOM_VERSION=y
BR2_LINUX_KERNEL_CUSTOM_VERSION_VALUE="6.6.14"
BR2_LINUX_KERNEL_USE_ARCH_DEFAULT_CONFIG=y
BR2_LINUX_KERNEL_CONFIG_FRAGMENT_FILES="$(BR2_EXTERNAL)/../../tf_core/buildroot_config/linux_fragment.config"

# Filesystem
BR2_TARGET_ROOTFS_SQUASHFS=y

# Packages (Minimal)
# No BusyBox or eudev in TUFF-OS (tuffd handles init and device discovery)
# BR2_PACKAGE_BUSYBOX is not set
# BR2_PACKAGE_EUDEV is not set
# Note: tuffd will be copied via overlay or post-build script
```
